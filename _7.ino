int buttons[6];
// место для переменных массива с 6 целыми числами
int buttons[0] = 2;
//присваивает первому елесенту массива значение 2
int notes[]={262,294,330,349};
//массив состоящий из частот,которые мы хотим воспроизвести
void setup() {
  Serial.begin(9600);
}
void loop() {
  int keyVal = analogRead(A0);
// переменная которая сохраняет значения полученные с порта А0
Serial.println(keyVal);
// теперь мы видим значения keyVal
if(keyVal == 1023){
// после каждого оператора if вызываем функцию tone.
// программа ссылается на массив,что определить на какой частоте играть
// если значение А0 условию то играеет определенный тон 
  tone(8, notes[0]);
}
else if(keyVal >= 990 && keyVal <=1010){
  tone(8, notes[1]);
}
else if(keyVal >= 505 && keyVal <=515){
  tone(8, notes[2]);
}
else if(keyVal >= 5 && keyVal <=10){
  tone(8, notes[3]);
}
else{
  noTone(8);
// остановка звкчания
}
}
